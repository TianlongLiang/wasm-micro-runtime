## CMakeLists.txt
```
# Copyright (C) 2019 Intel Corporation.  All rights reserved.
# SPDX-License-Identifier: Apache-2.0 WITH LLVM-exception

cmake_minimum_required(VERSION 3.14)

include(ExternalProject)

find_package(Zephyr REQUIRED HINTS $ENV{ZEPHYR_BASE})

project(coredump_debug LANGUAGES C)

# Select which WASM crash app to embed (oob or stackoverflow)
set(CRASH_APP "oob" CACHE STRING "WASM crash app to embed: oob or stackoverflow")

if(CRASH_APP STREQUAL "oob")
  add_definitions(-DCRASH_APP_OOB)
  message(STATUS "Crash app: out-of-bounds memory access")
elseif(CRASH_APP STREQUAL "stackoverflow")
  add_definitions(-DCRASH_APP_STACKOVERFLOW)
  message(STATUS "Crash app: stack overflow")
else()
  message(FATAL_ERROR "CRASH_APP must be 'oob' or 'stackoverflow', got: ${CRASH_APP}")
endif()

# --- Build WASM apps via ExternalProject ---
set(WASM_APPS_INSTALL_DIR "${CMAKE_CURRENT_BINARY_DIR}/wasm-apps")

ExternalProject_Add(wasm_apps
  SOURCE_DIR    "${CMAKE_CURRENT_SOURCE_DIR}/wasm-apps"
  BINARY_DIR    "${CMAKE_CURRENT_BINARY_DIR}/wasm-apps-build"
  INSTALL_DIR   "${WASM_APPS_INSTALL_DIR}"
  CMAKE_ARGS
    -DCMAKE_INSTALL_PREFIX=${WASM_APPS_INSTALL_DIR}
  BUILD_ALWAYS  TRUE
  STEP_TARGETS  install
)

add_subdirectory(lib-wamr-zephyr)

# Ensure WASM headers are generated before wamr_lib compiles
add_dependencies(wamr_lib wasm_apps-install)

target_link_libraries(app PRIVATE wamr_lib)

target_sources(app PRIVATE src/main.c)
```

## prj.conf
```kconfig
# Copyright (C) 2019 Intel Corporation.  All rights reserved.
# SPDX-License-Identifier: Apache-2.0 WITH LLVM-exception

CONFIG_PRINTK=y
CONFIG_LOG=y
CONFIG_LOG_BUFFER_SIZE=8096

# Zephyr coredump: log backend outputs hex to serial console
CONFIG_DEBUG_COREDUMP=y
CONFIG_DEBUG_COREDUMP_BACKEND_LOGGING=y
CONFIG_DEBUG_COREDUMP_MEMORY_DUMP_MIN=y

# Stack protection
CONFIG_STACK_SENTINEL=y
```

## src/main.c
```c
/*
 * Copyright (C) 2019 Intel Corporation.  All rights reserved.
 * SPDX-License-Identifier: Apache-2.0 WITH LLVM-exception
 */

#include <stdio.h>
#include <zephyr/kernel.h>

#define MAIN_THREAD_STACK_SIZE 8192
#define MAIN_THREAD_PRIORITY 5

extern void
iwasm_main(void *arg1, void *arg2, void *arg3);

K_THREAD_STACK_DEFINE(iwasm_main_thread_stack, MAIN_THREAD_STACK_SIZE);
static struct k_thread iwasm_main_thread;

int
main(void)
{
    k_tid_t tid = k_thread_create(
        &iwasm_main_thread, iwasm_main_thread_stack, MAIN_THREAD_STACK_SIZE,
        iwasm_main, NULL, NULL, NULL, MAIN_THREAD_PRIORITY, 0, K_NO_WAIT);

    return tid ? 0 : -1;
}
```
