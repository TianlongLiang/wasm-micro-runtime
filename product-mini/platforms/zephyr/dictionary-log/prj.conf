## CMakeLists.txt
```
# Copyright (C) 2025 Intel Corporation.  All rights reserved.
# SPDX-License-Identifier: Apache-2.0 WITH LLVM-exception

cmake_minimum_required(VERSION 3.14)

option(WAMR_ZEPHYR_DICT_LOG
       "Enable Zephyr dictionary logging for native logs (WASM dict always on)" ON)

if(WAMR_ZEPHYR_DICT_LOG)
  set(OVERLAY_CONFIG "${CMAKE_CURRENT_SOURCE_DIR}/overlay-dict.conf")
  message(STATUS "Zephyr dictionary logging: ON (native logs as binary)")
else()
  message(STATUS "Zephyr dictionary logging: OFF (native logs as text, WASM dict still active)")
endif()

find_package(Zephyr REQUIRED HINTS $ENV{ZEPHYR_BASE})

project(wamr_dictionary_log LANGUAGES C)

# --- Find wasi-sdk ---
if(NOT DEFINED WASI_SDK_DIR)
  foreach(_dir /opt/wasi-sdk /opt/wasi-sdk-25.0-x86_64-linux
               /opt/wasi-sdk-29.0-x86_64-linux $ENV{WASI_SDK_DIR})
    if(EXISTS "${_dir}/bin/clang")
      set(WASI_SDK_DIR "${_dir}")
      break()
    endif()
  endforeach()
endif()

# --- Baseline WASM build ---
set(WASM_APPS_DIR ${CMAKE_CURRENT_SOURCE_DIR}/wasm-apps)
set(WASM_BASELINE_SRCS
    ${WASM_APPS_DIR}/log_heavy_app.c
    ${WASM_APPS_DIR}/log_heavy_app_errors.c)
set(WASM_BASELINE_OUT ${CMAKE_CURRENT_BINARY_DIR}/log_heavy_app_baseline.wasm)
set(WASM_BASELINE_HEADER ${CMAKE_CURRENT_SOURCE_DIR}/lib-wamr-zephyr/test_wasm_baseline.h)

if(WASI_SDK_DIR)
  message(STATUS "WASI SDK: ${WASI_SDK_DIR}")
  set(WASI_CLANG ${WASI_SDK_DIR}/bin/clang)

  add_custom_command(
    OUTPUT ${WASM_BASELINE_OUT}
    COMMAND ${WASI_CLANG}
      --target=wasm32 -O2
      -DCUR_LOG_LEVEL=4
      -I ${WASM_APPS_DIR}
      -z stack-size=8192
      -Wl,--initial-memory=131072
      -Wl,--export=main
      -Wl,--export=__heap_base,--export=__data_end
      -Wl,--no-entry
      -Wl,--allow-undefined
      -nostdlib
      -o ${WASM_BASELINE_OUT} ${WASM_BASELINE_SRCS}
    DEPENDS ${WASM_BASELINE_SRCS} ${WASM_APPS_DIR}/wasm_log.h
              ${WASM_APPS_DIR}/sensor_app.h
    COMMENT "Compiling WASM baseline: log_heavy_app.c + log_heavy_app_errors.c -> log_heavy_app_baseline.wasm"
  )

  add_custom_command(
    OUTPUT ${WASM_BASELINE_HEADER}
    COMMAND ${CMAKE_COMMAND}
      -DWASM_IN=${WASM_BASELINE_OUT}
      -DHEADER_OUT=${WASM_BASELINE_HEADER}
      -DARRAY_NAME=wasm_test_file_baseline
      -P ${CMAKE_CURRENT_SOURCE_DIR}/cmake/wasm_to_header.cmake
    DEPENDS ${WASM_BASELINE_OUT}
    COMMENT "Generating WASM header: log_heavy_app_baseline.wasm -> test_wasm_baseline.h"
  )

  add_custom_target(wasm_baseline DEPENDS ${WASM_BASELINE_HEADER})

  # --- Dictionary mode: preprocessor-based extraction ---
  find_package(Python3 REQUIRED COMPONENTS Interpreter)

  set(EXTRACT_SCRIPT ${CMAKE_CURRENT_SOURCE_DIR}/scripts/extract_log_strings.py)
  set(WASM_DICT_SRCS
      ${CMAKE_CURRENT_BINARY_DIR}/log_heavy_app_dict.i
      ${CMAKE_CURRENT_BINARY_DIR}/log_heavy_app_errors_dict.i)
  set(WASM_DICT_JSON ${CMAKE_CURRENT_BINARY_DIR}/wasm_log_dict.json)
  set(WASM_DICT_OUT ${CMAKE_CURRENT_BINARY_DIR}/log_heavy_app_dict.wasm)
  set(WASM_DICT_HEADER ${CMAKE_CURRENT_SOURCE_DIR}/lib-wamr-zephyr/test_wasm_dict.h)

  # Extract log strings via preprocessor and generate transformed .i source
  add_custom_command(
    OUTPUT ${CMAKE_CURRENT_BINARY_DIR}/log_heavy_app_dict.i
           ${CMAKE_CURRENT_BINARY_DIR}/log_heavy_app_errors_dict.i
           ${WASM_DICT_JSON}
    COMMAND ${Python3_EXECUTABLE} ${EXTRACT_SCRIPT}
      --clang ${WASI_CLANG}
      --target wasm32
      -I ${WASM_APPS_DIR}
      -D CUR_LOG_LEVEL=4
      -o-dir ${CMAKE_CURRENT_BINARY_DIR}
      -j ${WASM_DICT_JSON}
      ${WASM_BASELINE_SRCS}
    DEPENDS ${WASM_BASELINE_SRCS} ${WASM_APPS_DIR}/wasm_log.h
            ${WASM_APPS_DIR}/sensor_app.h ${EXTRACT_SCRIPT}
    COMMENT "Extracting log strings (preprocess) for sensor app"
  )

  # Compile dictionary WASM from preprocessed .i files
  add_custom_command(
    OUTPUT ${WASM_DICT_OUT}
    COMMAND ${WASI_CLANG}
      --target=wasm32 -O2
      -DWASM_LOG_DICT
      -z stack-size=8192
      -Wl,--initial-memory=131072
      -Wl,--export=main
      -Wl,--export=__heap_base,--export=__data_end
      -Wl,--no-entry
      -Wl,--allow-undefined
      -nostdlib
      -o ${WASM_DICT_OUT} ${WASM_DICT_SRCS}
    DEPENDS ${WASM_DICT_SRCS}
    COMMENT "Compiling sensor dict WASM from preprocessed .i files"
  )

  # Convert to C header
  add_custom_command(
    OUTPUT ${WASM_DICT_HEADER}
    COMMAND ${CMAKE_COMMAND}
      -DWASM_IN=${WASM_DICT_OUT}
      -DHEADER_OUT=${WASM_DICT_HEADER}
      -DARRAY_NAME=wasm_test_file_dict
      -P ${CMAKE_CURRENT_SOURCE_DIR}/cmake/wasm_to_header.cmake
    DEPENDS ${WASM_DICT_OUT}
    COMMENT "Generating header: log_heavy_app_dict.wasm -> test_wasm_dict.h"
  )

  add_custom_target(wasm_dict DEPENDS ${WASM_DICT_HEADER} ${WASM_DICT_JSON})

  # --- Size comparison ---
  add_custom_command(TARGET wasm_dict POST_BUILD
    COMMAND ${CMAKE_COMMAND} -E echo "===== WASM Size Comparison ====="
    COMMAND ${CMAKE_COMMAND} -E echo "--- Sensor App ---"
    COMMAND ls -la ${WASM_BASELINE_OUT}
    COMMAND ls -la ${WASM_DICT_OUT}
    COMMAND ${CMAKE_COMMAND} -E echo "--- Network App ---"
    COMMAND ls -la ${WASM_NET_BASELINE_OUT}
    COMMAND ls -la ${WASM_NET_DICT_OUT}
    COMMAND ${CMAKE_COMMAND} -E echo "================================"
  )

  # --- Network app: baseline + dictionary builds ---
  set(WASM_NET_SRC ${WASM_APPS_DIR}/log_app_network.c)
  set(WASM_NET_BASELINE_OUT ${CMAKE_CURRENT_BINARY_DIR}/log_app_network_baseline.wasm)
  set(WASM_NET_BASELINE_HEADER ${CMAKE_CURRENT_SOURCE_DIR}/lib-wamr-zephyr/test_wasm_network_baseline.h)

  # Network baseline (with format strings)
  add_custom_command(
    OUTPUT ${WASM_NET_BASELINE_OUT}
    COMMAND ${WASI_CLANG}
      --target=wasm32 -O2
      -DCUR_LOG_LEVEL=4
      -I ${WASM_APPS_DIR}
      -z stack-size=8192
      -Wl,--initial-memory=131072
      -Wl,--export=main
      -Wl,--export=__heap_base,--export=__data_end
      -Wl,--no-entry
      -Wl,--allow-undefined
      -nostdlib
      -o ${WASM_NET_BASELINE_OUT} ${WASM_NET_SRC}
    DEPENDS ${WASM_NET_SRC} ${WASM_APPS_DIR}/wasm_log.h
    COMMENT "Compiling network baseline: log_app_network.c -> log_app_network_baseline.wasm"
  )

  add_custom_command(
    OUTPUT ${WASM_NET_BASELINE_HEADER}
    COMMAND ${CMAKE_COMMAND}
      -DWASM_IN=${WASM_NET_BASELINE_OUT}
      -DHEADER_OUT=${WASM_NET_BASELINE_HEADER}
      -DARRAY_NAME=wasm_test_file_network_baseline
      -P ${CMAKE_CURRENT_SOURCE_DIR}/cmake/wasm_to_header.cmake
    DEPENDS ${WASM_NET_BASELINE_OUT}
    COMMENT "Generating header: log_app_network_baseline.wasm -> test_wasm_network_baseline.h"
  )

  add_custom_target(wasm_network_baseline DEPENDS ${WASM_NET_BASELINE_HEADER})
  set(WASM_NET_DICT_SRC ${CMAKE_CURRENT_BINARY_DIR}/log_app_network_dict.i)
  set(WASM_NET_DICT_JSON ${CMAKE_CURRENT_BINARY_DIR}/wasm_log_dict_network.json)
  set(WASM_NET_DICT_OUT ${CMAKE_CURRENT_BINARY_DIR}/log_app_network_dict.wasm)
  set(WASM_NET_DICT_HEADER ${CMAKE_CURRENT_SOURCE_DIR}/lib-wamr-zephyr/test_wasm_network.h)

  # Extract log strings via preprocessor and generate transformed .i source
  add_custom_command(
    OUTPUT ${WASM_NET_DICT_SRC} ${WASM_NET_DICT_JSON}
    COMMAND ${Python3_EXECUTABLE} ${EXTRACT_SCRIPT}
      --clang ${WASI_CLANG}
      --target wasm32
      -I ${WASM_APPS_DIR}
      -D CUR_LOG_LEVEL=4
      -o-dir ${CMAKE_CURRENT_BINARY_DIR}
      -j ${WASM_NET_DICT_JSON}
      ${WASM_NET_SRC}
    DEPENDS ${WASM_NET_SRC} ${WASM_APPS_DIR}/wasm_log.h ${EXTRACT_SCRIPT}
    COMMENT "Extracting log strings (preprocess) for network app"
  )

  # Compile dictionary WASM from preprocessed .i file
  add_custom_command(
    OUTPUT ${WASM_NET_DICT_OUT}
    COMMAND ${WASI_CLANG}
      --target=wasm32 -O2
      -DWASM_LOG_DICT
      -z stack-size=8192
      -Wl,--initial-memory=131072
      -Wl,--export=main
      -Wl,--export=__heap_base,--export=__data_end
      -Wl,--no-entry
      -Wl,--allow-undefined
      -nostdlib
      -o ${WASM_NET_DICT_OUT} ${WASM_NET_DICT_SRC}
    DEPENDS ${WASM_NET_DICT_SRC}
    COMMENT "Compiling network dict WASM from preprocessed .i"
  )

  # Convert to C header
  add_custom_command(
    OUTPUT ${WASM_NET_DICT_HEADER}
    COMMAND ${CMAKE_COMMAND}
      -DWASM_IN=${WASM_NET_DICT_OUT}
      -DHEADER_OUT=${WASM_NET_DICT_HEADER}
      -DARRAY_NAME=wasm_test_file_network
      -P ${CMAKE_CURRENT_SOURCE_DIR}/cmake/wasm_to_header.cmake
    DEPENDS ${WASM_NET_DICT_OUT}
    COMMENT "Generating header: log_app_network_dict.wasm -> test_wasm_network.h"
  )

  add_custom_target(wasm_network DEPENDS ${WASM_NET_DICT_HEADER} ${WASM_NET_DICT_JSON})

  # --- Stitch per-app dictionaries into unified JSON ---
  set(STITCH_SCRIPT ${CMAKE_CURRENT_SOURCE_DIR}/scripts/stitch_wasm_dicts.py)
  set(WASM_UNIFIED_DICT ${CMAKE_CURRENT_BINARY_DIR}/wasm_unified_dict.json)

  add_custom_command(
    OUTPUT ${WASM_UNIFIED_DICT}
    COMMAND ${Python3_EXECUTABLE} ${STITCH_SCRIPT}
      --app 0:sensor_app:${WASM_DICT_JSON}
      --app 1:network_app:${WASM_NET_DICT_JSON}
      -o ${WASM_UNIFIED_DICT}
    DEPENDS ${WASM_DICT_JSON} ${WASM_NET_DICT_JSON} ${STITCH_SCRIPT}
    COMMENT "Stitching per-app dictionaries -> wasm_unified_dict.json"
  )

  add_custom_target(wasm_unified_dict DEPENDS ${WASM_UNIFIED_DICT})
  add_dependencies(wasm_unified_dict wasm_dict wasm_network)

else()
  message(STATUS "WASI SDK not found - using pre-built headers")
  add_custom_target(wasm_baseline)
  add_custom_target(wasm_dict)
  add_custom_target(wasm_network_baseline)
  add_custom_target(wasm_network)
  add_custom_target(wasm_unified_dict)
endif()

# --- WAMR library ---
add_subdirectory(lib-wamr-zephyr)

# Ensure the WASM headers and unified dict are generated before compiling the WAMR library
add_dependencies(wamr_lib wasm_baseline wasm_dict wasm_network_baseline wasm_network wasm_unified_dict)

set(WAMR_ROOT ${CMAKE_CURRENT_SOURCE_DIR}/../../../..)

target_link_libraries(app PRIVATE wamr_lib)

target_include_directories(app PRIVATE
  ${CMAKE_CURRENT_SOURCE_DIR}/lib-wamr-zephyr
  ${WAMR_ROOT}/core/iwasm/include
  ${WAMR_ROOT}/core/shared/utils
  ${WAMR_ROOT}/core/shared/platform/include
  ${WAMR_ROOT}/core/shared/platform/zephyr
)

target_sources(app PRIVATE
  src/main.c
)

# Force kernel symbols needed by WAMR to be linked
zephyr_link_libraries(
  -Wl,--undefined=z_impl_k_msgq_put
  -Wl,--undefined=z_impl_k_msgq_get
  -Wl,--undefined=k_msgq_init
  -Wl,--undefined=z_impl_k_msgq_purge
  -Wl,--undefined=z_impl_k_sem_init
  -Wl,--undefined=z_impl_k_sem_take
  -Wl,--undefined=z_impl_k_sem_give
)
if(CONFIG_USERSPACE AND CONFIG_DYNAMIC_OBJECTS)
  zephyr_link_libraries(
    -Wl,--undefined=z_impl_k_condvar_init
    -Wl,--undefined=z_impl_k_condvar_signal
    -Wl,--undefined=z_impl_k_condvar_wait
    -Wl,--undefined=z_impl_k_condvar_broadcast
  )
endif()
```

## prj.conf
```kconfig
CONFIG_USERSPACE=y
CONFIG_STACK_SENTINEL=y
CONFIG_PRINTK=y
CONFIG_LOG=y
CONFIG_LOG_BUFFER_SIZE=32768
CONFIG_LOG_BACKEND_UART=y
CONFIG_THREAD_RUNTIME_STATS=y
CONFIG_LOG_FUNC_NAME_PREFIX_DBG=n
```

## overlay-dict.conf
```kconfig
# Dictionary logging overlay — applied when WAMR_ZEPHYR_DICT_LOG=ON (default)
CONFIG_LOG_BACKEND_UART_OUTPUT_DICTIONARY=y
CONFIG_LOG_BACKEND_UART_OUTPUT_DICTIONARY_HEX=y
```

## src/main.c
```c
/*
 * Copyright (C) 2025 Intel Corporation.  All rights reserved.
 * SPDX-License-Identifier: Apache-2.0 WITH LLVM-exception
 */

#include <stdio.h>
#include <zephyr/kernel.h>
#include <zephyr/version.h>
#include <zephyr/logging/log.h>
#include <zephyr/app_memory/app_memdomain.h>

LOG_MODULE_REGISTER(dict_log_demo, LOG_LEVEL_DBG);

#define MAIN_THREAD_STACK_SIZE 4096
#define MAIN_THREAD_PRIORITY 5

static struct k_thread iwasm_user_mode_thread;
K_THREAD_STACK_DEFINE(iwasm_user_mode_thread_stack, MAIN_THREAD_STACK_SIZE);

extern struct k_mem_partition z_libc_partition;
K_APPMEM_PARTITION_DEFINE(wamr_partition);

/* WAMR memory domain */
struct k_mem_domain wamr_domain;

extern void
iwasm_main(void *arg1, void *arg2, void *arg3);

/* Set up a Zephyr userspace thread with memory domain for WAMR. */
static bool
iwasm_user_mode(void)
{
    struct k_mem_partition *wamr_domain_parts[] = { &wamr_partition,
                                                    &z_libc_partition };

    printk("wamr_partition start addr: %ld, size: %zu\n",
           wamr_partition.start, wamr_partition.size);

    /* Initialize the memory domain with WAMR and libc partitions */
    if (k_mem_domain_init(&wamr_domain, 2, wamr_domain_parts) != 0) {
        printk("Failed to initialize memory domain.\n");
        return false;
    }

    k_tid_t tid =
        k_thread_create(&iwasm_user_mode_thread, iwasm_user_mode_thread_stack,
                        MAIN_THREAD_STACK_SIZE, iwasm_main, NULL, NULL, NULL,
                        MAIN_THREAD_PRIORITY, K_USER, K_FOREVER);

    /* Grant WAMR memory domain access to user mode thread */
    if (k_mem_domain_add_thread(&wamr_domain, tid) != 0) {
        printk("Failed to add memory domain to thread.\n");
        return false;
    }

#if KERNEL_VERSION_NUMBER < 0x040000 /* version 4.0.0 */
    k_thread_start(tid);
#else
    /* wakes up thread from sleeping */
    k_wakeup(tid);
#endif

    return tid ? true : false;
}

int
main(void)
{
    uint32_t uptime = k_uptime_get_32();

    LOG_INF("=== Dictionary Logging Demo ===");
    LOG_INF("Zephyr OS build: %s", STRINGIFY(BUILD_VERSION));
    LOG_INF("Board: %s", CONFIG_BOARD);
    LOG_INF("System uptime at boot: %u ms", uptime);

    LOG_ERR("Native ERR: error code %d on subsystem %d", -5, 3);
    LOG_WRN("Native WRN: retry count %u exceeds threshold %u", 100, 50);
    LOG_INF("Native INF: sensor %s initialized, channels=%d", "BME280", 3);
    LOG_DBG("Native DBG: heap free=%u used=%u total=%u bytes", 32768, 32768, 65536);

    LOG_INF("Native log: memory partition start=0x%x size=%u",
            (uint32_t)wamr_partition.start, (uint32_t)wamr_partition.size);
    LOG_DBG("Native log: thread stack size=%d priority=%d",
            MAIN_THREAD_STACK_SIZE, MAIN_THREAD_PRIORITY);
    LOG_INF("Native log: CONFIG_USERSPACE=%d CONFIG_LOG=y", 1);
    LOG_WRN("Native log: dictionary hex mode active, raw UART output");
    LOG_DBG("Native log: log buffer size=%d bytes", 32768);
    LOG_INF("Native log: WAMR global heap pool=%d bytes", 131072);

    LOG_INF("--- Native Zephyr dictionary logging verified ---");
    LOG_INF("Starting WAMR userspace thread for WASM log comparison...");
    iwasm_user_mode();

    /* Wait for WASM thread to finish */
    k_thread_join(&iwasm_user_mode_thread, K_FOREVER);

    uint32_t end_uptime = k_uptime_get_32();
    LOG_INF("=== WASM apps finished ===");
    LOG_INF("Total elapsed: %u ms", end_uptime - uptime);
    LOG_INF("Baseline WASM: format strings in data segment (runtime formatting)");
    LOG_INF("Dictionary WASM: string IDs only (binary packets, offline decode)");
    LOG_INF("Baseline: 13288 bytes, Dictionary: 5721 bytes (57%% reduction)");
    LOG_INF("--- Demo complete ---");

    return 0;
}
```
