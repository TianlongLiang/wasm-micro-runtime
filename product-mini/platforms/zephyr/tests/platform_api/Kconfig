## product-mini/platforms/zephyr/tests/platform_api/Kconfig
```kconfig
# Copyright (C) 2026 Intel Corporation.  All rights reserved.
# SPDX-License-Identifier: Apache-2.0 WITH LLVM-exception

mainmenu "WAMR Zephyr platform API tests"
source "Kconfig.zephyr"

config WAMR_TEST_USER_MODE
    bool "Run applicable WAMR tests as user threads"
    default n

config WAMR_ZEPHYR_TEST_MOCKS
    bool "Enable mocked-error platform API tests"
    default n
    depends on ZTEST && !USERSPACE
    help
      Enable narrow WAMR-owned seams for the dedicated native_sim
      mocked-error platform API scenario. Never enable in production.
      The prompt exists solely so Twister can select the isolated test
      scenario through extra_configs.
```
